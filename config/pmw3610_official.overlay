/*
 * A/B test variant: replace only the PMW3610 implementation while preserving
 * the board, ZMK revision, keymap, 400 CPI, and scroll behavior.
 *
 * Do not apply axis swapping or sign inversion. On-device testing showed that
 * the prior transform exchanged horizontal and vertical movement.
 */
&trackball {
    compatible = "pixart,pmw3610";

    /delete-property/ irq-gpios;
    /delete-property/ cpi;
    /delete-property/ swap-xy;
    /delete-property/ invert-x;
    /delete-property/ invert-y;
    /delete-property/ evt-type;
    /delete-property/ x-input-code;
    /delete-property/ y-input-code;

    motion-gpios = <&gpio0 6 (GPIO_ACTIVE_LOW | GPIO_PULL_UP)>;
    zephyr,axis-x = <INPUT_REL_X>;
    zephyr,axis-y = <INPUT_REL_Y>;
    res-cpi = <400>;
    smart-mode;
};
